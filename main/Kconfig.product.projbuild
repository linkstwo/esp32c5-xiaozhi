## main/Kconfig.product.projbuild
```kconfig
menu "ESP32-C5 XiaoZhi Product"

config OTA_URL
    string "Default OTA URL"
    default "https://api.tenclass.net/xiaozhi/ota/"
    help
        OTA and server configuration endpoint used by the product firmware.

config XIAOZHI_ENABLE_WEBSOCKET_PROTOCOL
    bool "Enable WebSocket protocol backend"
    default n
    help
        Product firmware uses MQTT + UDP by default. Keep this disabled unless
        a future product variant explicitly needs WebSocket.

choice
    prompt "Flash Assets"
    default FLASH_DEFAULT_ASSETS

    config FLASH_NONE_ASSETS
        bool "Do not flash assets"
    config FLASH_DEFAULT_ASSETS
        bool "Flash Default Assets"
    config FLASH_CUSTOM_ASSETS
        bool "Flash Custom Assets"
endchoice

config CUSTOM_ASSETS_FILE
    depends on FLASH_CUSTOM_ASSETS
    string "Custom Assets File"
    default "assets.bin"

choice
    prompt "Default Language"
    default LANGUAGE_ZH_CN

    config LANGUAGE_ZH_CN
        bool "Chinese Simplified"
endchoice

choice BOARD_TYPE
    prompt "Board Type"
    default BOARD_TYPE_ESP_SENSAIRSHUTTLE

    config BOARD_TYPE_ESP_SENSAIRSHUTTLE
        bool "ESP32-C5 XiaoZhi Product Board / ESP-SensairShuttle"
        depends on IDF_TARGET_ESP32C5
endchoice

config USE_AUDIO_PROCESSOR
    bool "Use AFE audio processor"
    default n
    help
        Keep disabled for the ESP32-C5 product baseline. Raw mic passthrough is
        lighter and easier to stabilize.

config USE_SERVER_AEC
    bool "Use server-side AEC"
    default n

config USE_ESP_WAKE_WORD
    bool "Use ESP wake word"
    default n
    help
        Disabled in the product baseline to reduce memory pressure. Re-enable
        only after the MQTT + UDP voice path is stable.

config WAKE_WORD_DISABLED
    bool "Disable wake word"
    default y

config USE_EMOTE_MESSAGE_STYLE
    bool "Use emote display style"
    default n
    help
        Product baseline uses SmartGadgetDisplay, not EmoteDisplay.

config CODEC_DATA_ADC_SUPPORT
    bool "Enable ADC microphone codec support"
    default y

endmenu
```

## sdkconfig.defaults
```kconfig
CONFIG_COMPILER_OPTIMIZATION_SIZE=y
CONFIG_COMPILER_CXX_EXCEPTIONS=y
CONFIG_COMPILER_CXX_EXCEPTIONS_EMG_POOL_SIZE=1024
CONFIG_COMPILER_CXX_RTTI=y

CONFIG_BOOTLOADER_COMPILER_OPTIMIZATION_PERF=y
CONFIG_BOOTLOADER_LOG_LEVEL_NONE=y
CONFIG_BOOTLOADER_SKIP_VALIDATE_ALWAYS=y
CONFIG_BOOTLOADER_APP_ROLLBACK_ENABLE=y

CONFIG_HTTPD_MAX_REQ_HDR_LEN=2048
CONFIG_HTTPD_MAX_URI_LEN=2048

CONFIG_PARTITION_TABLE_CUSTOM=y
CONFIG_PARTITION_TABLE_CUSTOM_FILENAME="partitions/v2/16m.csv"
CONFIG_PARTITION_TABLE_OFFSET=0x8000

CONFIG_ESP_TASK_WDT_TIMEOUT_S=10
CONFIG_FREERTOS_GENERATE_RUN_TIME_STATS=y
CONFIG_FREERTOS_USE_STATS_FORMATTING_FUNCTIONS=y

CONFIG_ESP_MAIN_TASK_STACK_SIZE=8192
CONFIG_MBEDTLS_DYNAMIC_BUFFER=y
CONFIG_MBEDTLS_SSL_KEEP_PEER_CERTIFICATE=n
CONFIG_ESP_WIFI_IRAM_OPT=n
CONFIG_ESP_WIFI_RX_IRAM_OPT=n
CONFIG_ESP_WIFI_DYNAMIC_RX_MGMT_BUFFER=y

# Product target: ESP32-C5 XiaoZhi board
CONFIG_IDF_TARGET="esp32c5"
CONFIG_BOARD_TYPE_ESP_SENSAIRSHUTTLE=y
CONFIG_XIAOZHI_ENABLE_WEBSOCKET_PROTOCOL=n
CONFIG_USE_EMOTE_MESSAGE_STYLE=n
CONFIG_USE_ESP_WAKE_WORD=n

# ESP32-C5 memory-oriented Wi-Fi defaults
CONFIG_ESP_WIFI_STATIC_RX_BUFFER_NUM=3
CONFIG_ESP_WIFI_DYNAMIC_RX_BUFFER_NUM=6
CONFIG_ESP_WIFI_AMPDU_TX_ENABLED=n
CONFIG_ESP_WIFI_ENABLE_WPA3_SAE=n
CONFIG_ESP_WIFI_ENTERPRISE_SUPPORT=n
CONFIG_ESP_WIFI_ESPNOW_MAX_ENCRYPT_NUM=0
CONFIG_LWIP_IPV6=n
CONFIG_LWIP_TCPIP_TASK_STACK_SIZE=2048

CONFIG_NEWLIB_NANO_FORMAT=y
CONFIG_CODEC_I2C_BACKWARD_COMPATIBLE=n

# Fix ML307 FIFO Overflow. Kept for now until the 4G path is fully removed from CMake.
CONFIG_UART_ISR_IN_IRAM=y

# Fix ESP_SSL error
CONFIG_MBEDTLS_SSL_RENEGOTIATION=n
CONFIG_MBEDTLS_SSL_IN_CONTENT_LEN=8192
CONFIG_MBEDTLS_DYNAMIC_FREE_CONFIG_DATA=y

# Optional PSRAM support for product board variants that provide it.
CONFIG_SPIRAM=y
CONFIG_SPIRAM_MALLOC_ALWAYSINTERNAL=3072
CONFIG_SPIRAM_TRY_ALLOCATE_WIFI_LWIP=y

# LVGL 9.2.2
CONFIG_LV_OS_NONE=y
CONFIG_LV_USE_CLIB_MALLOC=y
CONFIG_LV_USE_CLIB_STRING=y
CONFIG_LV_USE_CLIB_SPRINTF=y
CONFIG_LV_USE_IMGFONT=y
CONFIG_LV_USE_ASSERT_STYLE=y

# Use compressed font
CONFIG_LV_FONT_FMT_TXT_LARGE=y
CONFIG_LV_USE_FONT_COMPRESSED=n
CONFIG_LV_USE_FONT_PLACEHOLDER=n
CONFIG_LV_USE_LODEPNG=y

# ESP32-C5 display memory defaults
CONFIG_LV_DRAW_LAYER_SIMPLE_BUF_SIZE=16384

# Disable extra widgets to save flash size
CONFIG_LV_USE_ANIMIMG=n
CONFIG_LV_USE_CALENDAR=n
CONFIG_LV_USE_CALENDAR_HEADER_ARROW=n
CONFIG_LV_USE_CALENDAR_HEADER_DROPDOWN=n
CONFIG_LV_USE_CHART=n
CONFIG_LV_USE_KEYBOARD=n
CONFIG_LV_USE_LED=n
CONFIG_LV_USE_LIST=n
CONFIG_LV_USE_MENU=n
CONFIG_LV_USE_MSGBOX=n
CONFIG_LV_USE_SPAN=n
CONFIG_LV_USE_SPINBOX=n
CONFIG_LV_USE_SPINNER=n
CONFIG_LV_USE_TABVIEW=n
CONFIG_LV_USE_TILEVIEW=n
CONFIG_LV_USE_WIN=n

CONFIG_LV_BUILD_EXAMPLES=n
CONFIG_LV_BUILD_DEMOS=n
```
